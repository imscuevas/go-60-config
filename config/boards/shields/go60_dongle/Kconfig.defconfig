## config/boards/shields/go60_dongle/Kconfig.shield
```kconfig
# Copyright (c) 2024 The ZMK Contributors
# SPDX-License-Identifier: MIT

config SHIELD_GO60_DONGLE
    def_bool $(shields_list_contains,go60_dongle)
```

## config/boards/shields/go60_lh_peripheral/Kconfig.defconfig
```kconfig
# Copyright (c) 2024 The ZMK Contributors
# SPDX-License-Identifier: MIT

if SHIELD_GO60_LH_PERIPHERAL

config ZMK_SPLIT_ROLE_CENTRAL
    default n

config ZMK_SPLIT
    default y

config ZMK_USB
    default n

endif
```
